## boards/shields/pisey/Kconfig.defconfig
```kconfig
if SHIELD_PISEY_LEFT || SHIELD_PISEY_RIGHT

config ZMK_SPLIT
    default y

config ZMK_KEYBOARD_NAME
    default "pisey"

config ZMK_POINTING
    default y

config ZMK_MK_POINTING
    default y

config ZMK_SPLIT_PERIPHERAL_POINTER_DATA
    default y

config BT_MAX_CONN
  default 6

config BT_MAX_PAIRED
  default 6

endif

if SHIELD_PISEY_DONGLE

# Name must be less than 16 characters long!
config ZMK_KEYBOARD_NAME
    default "pisey_dongle"

config ZMK_SPLIT
    default y

config ZMK_SPLIT_ROLE_CENTRAL
    default y

config ZMK_SPLIT_BLE_CENTRAL_PERIPHERALS
  default 2

config ZMK_POINTING
    default y

config ZMK_MK_POINTING
    default y

config BT_MAX_CONN
  default 7

config BT_MAX_PAIRED
  default 7

endif
```

## boards/shields/pisey/Kconfig.shield
```kconfig
config SHIELD_PISEY_LEFT
    def_bool $(shields_list_contains,pisey_left)

config SHIELD_PISEY_RIGHT
    def_bool $(shields_list_contains,pisey_right)

config SHIELD_PISEY_DONGLE
    def_bool $(shields_list_contains,pisey_dongle)
```

## config/west.yml
```yaml
manifest:
  remotes:
    - name: zmkfirmware
      url-base: https://github.com/zmkfirmware
    - name: badjeff
      url-base: https://github.com/badjeff
    - name: damex
      url-base: https://github.com/damex
    - name: charlesmst
      url-base: https://github.com/charlesmst

  projects:
    - name: zmk
      remote: charlesmst
      revision: feat/deskhop-sync
      import: app/west.yml
    - name: zmk-behavior-battery-percentage-printer
      remote: badjeff
      revision: main
    - name: zmk-feature-split-esb
      remote: damex
      revision: v0.3.6
      import: true
  self:
    path: config
```
