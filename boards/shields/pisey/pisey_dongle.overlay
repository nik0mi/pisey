#include "pisey.dtsi"
#include "pisey_esb_addr.dtsi"

/ {
    chosen {
        zmk,kscan = &kscan_dongle;
        zmk,matrix_transform = &matrix_transform0;
    };

    kscan_dongle: kscan_dongle {
        compatible = "zmk,kscan-mock";
        columns = <0>;
        rows = <0>;
        events = <0>;
    };
};

&physical_layout_pisey {
    kscan = <&kscan_dongle>;
};
